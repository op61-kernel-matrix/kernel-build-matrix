## kalisu/Kconfig
```kconfig
menu "KaliSU"

config KSU
	tristate "KaliSU function support"
	depends on KPROBES && EXT4_FS
	default y
	help
	  Enable kernel-level root privileges on Android System.
	  Requires CONFIG_KPROBES for kernel hooking support.
	  Requires CONFIG_EXT4_FS for `ext4_unregister_sysfs`.
	  To compile as a module, choose M here: the
	  module will be called kalisu.

config KSU_DEBUG
	bool "KaliSU debug mode"
	depends on KSU
	default n
	help
	  Enable KaliSU debug mode.

config KALISU_BLOCK_MODULES_DEFAULT
	string "KaliSU native module blocklist"
	depends on KSU
	default ""
	help
	  Comma-separated kernel module names that KaliSU will add to the
	  kernel's native module_blacklist during core initialization. Keep this
	  empty for generic kernels. A device-specific canary may set only module
	  names that have been audited for that device's first-stage boot graph.

config KSU_MANUAL_SU
    bool "Use manual su"
    depends on KSU
    default y
    help
      Use manual su and authorize the corresponding command line and application via prctl

config KSU_DISABLE_MANAGER
	bool "Disable KaliSU manager integration"
	depends on KSU
	default n
	help
	  Disable manager APK detection and manager-specific handling.
	  Root will be used in place of manager-only functionality.

config KSU_DISABLE_POLICY
	bool "Disable KaliSU policy profiles"
	depends on KSU
	default n
	help
	  Disable per-app root/non-root profile customization.
	  Escalation will always use the default full root profile, and
	  non-root handling will follow the global umount policy only.

config KSU_X86_PATCH_SYSCALL_DISPATCHER
	bool "Dynamically patch x64's hardened syscall dispatcher to support syscall hooks"
	depends on KSU && X86_64
	default n
	help
	  Dynamically patch x64's hardened syscall dispatcher to support syscall hooks. This is a
	  replacement for a kernel source code patch, and is useful for x86_64 LKM mode.

endmenu
```
